## boards/native_sim.conf
```kconfig
# Copyright (c) 2025-2026 Tilmann Unte
# SPDX-License-Identifier:  Apache-2.0

# Activate UART serial connection (Debug, Magni, RPLIDAR)
CONFIG_SERIAL=y
CONFIG_UART_INTERRUPT_DRIVEN=y

# Native Sim specific Settings
CONFIG_ASAN=y
CONFIG_UBSAN=y
#CONFIG_COVERAGE=y

#CONFIG_SYS_CLOCK_TICKS_PER_SEC=100000

################################################################################
# Include Magni Driver
CONFIG_APPLICATION_DEFINED_SYSCALL=y
CONFIG_UR_MAGNI_DRIVER=y

# Include Slamtech RPLidar Driver
CONFIG_RPLIDAR=y
```

## boards/stm32_min_dev_blue.conf
```kconfig
# Copyright (c) 2026 Tilmann Unte
# SPDX-License-Identifier:  Apache-2.0

################################################################################
# Board needs minimized footprint, otherwise the application will not fit
CONFIG_SCHED_SIMPLE=y
CONFIG_WAITQ_SIMPLE=y
CONFIG_MINIMAL_LIBC=y
#CONFIG_LOG_MODE_IMMEDIATE=y # in conflict with DEFERRED!
# ERR&WRN&INF&DBG=4, ERR&WRN&INF=3, ERR&WRN=2, ERR=1, (None)=0
#CONFIG_LOG_MAX_LEVEL=3
CONFIG_LOG_SPEED=n
CONFIG_LOG_PROCESS_THREAD=n
CONFIG_LIBFIXMATH_SINLUT=n
CONFIG_ISR_STACK_SIZE=512
CONFIG_IDLE_STACK_SIZE=128
# We don't use a main thread, but I have not checked whether the main stack is necessary
CONFIG_MAIN_STACK_SIZE=512
CONFIG_SPI=n
CONFIG_I2C=n
CONFIG_PWM=n
CONFIG_ADC=n
CONFIG_CAN=n

CONFIG_DEBUG=n
CONFIG_DEBUG_THREAD_INFO=y

CONFIG_LOG=y
CONFIG_LOG_MODE_MINIMAL=y
#CONFIG_LOG_BUFFER_SIZE=2560

# ASSERT is important to determine system health, but the application won't fit ROM with it enabled
CONFIG_ASSERT=n

# Activate UART serial connection (Debug, Magni, RPLIDAR)
CONFIG_SERIAL=y
CONFIG_UART_INTERRUPT_DRIVEN=y

#CONFIG_SRAM_VECTOR_TABLE=y
#CONFIG_SRAM_SW_ISR_TABLE=y

################################################################################
# Include Magni Driver
#CONFIG_APPLICATION_DEFINED_SYSCALL=y
CONFIG_UR_MAGNI_DRIVER=y

# Include Slamtech RPLidar Driver
CONFIG_RPLIDAR=y
CONFIG_RPLIDAR_EXPRESS_MODE=n

################################################################################
```

## boards/stm32f4_disco.conf
```kconfig
# Copyright (c) 2021-2026 Tilmann Unte
# SPDX-License-Identifier:  Apache-2.0

################################################################################
# Activate UART serial connection (Debug, Magni, RPLIDAR)
CONFIG_SERIAL=y
CONFIG_UART_INTERRUPT_DRIVEN=y

# Overflow protection
CONFIG_HW_STACK_PROTECTION=y

CONFIG_SRAM_VECTOR_TABLE=y
CONFIG_SRAM_SW_ISR_TABLE=y

################################################################################
# Include Magni Driver
CONFIG_APPLICATION_DEFINED_SYSCALL=y
CONFIG_UR_MAGNI_DRIVER=y

# Include Slamtech RPLidar Driver
CONFIG_RPLIDAR=y

################################################################################
```

## boards/xmc45_relax_kit.conf
```kconfig
# Copyright (c) 2025-2026 Tilmann Unte
# SPDX-License-Identifier:  Apache-2.0

# Activate UART serial connection (Debug, Magni, RPLIDAR)
CONFIG_SERIAL=y
CONFIG_UART_INTERRUPT_DRIVEN=y

CONFIG_SRAM_VECTOR_TABLE=y
CONFIG_SRAM_SW_ISR_TABLE=y

# Overflow protection
CONFIG_HW_STACK_PROTECTION=y

################################################################################
# Include Magni Driver
CONFIG_APPLICATION_DEFINED_SYSCALL=y
CONFIG_UR_MAGNI_DRIVER=y

# Include Slamtech RPLidar Driver
CONFIG_RPLIDAR=y
```

## helpmath/Kconfig
```kconfig
# Copyright (c) 2025-2026 Tilmann Unte
# SPDX-License-Identifier:  Apache-2.0

config HELPMATH
	bool "Enable helper math library"
	depends on LIBFIXMATH
```

## kalman/Kconfig
```kconfig
# Copyright (c) 2025-2026 Tilmann Unte
# SPDX-License-Identifier:  Apache-2.0

config KALMAN_FILTER
	bool "Enable support for adaptive 1D Kalman Filter"
	depends on RPLIDAR
	depends on LIBFIXMATH
```

## libfixmath/Kconfig
```kconfig
# Copyright (c) 2025-2026 Tilmann Unte
# SPDX-License-Identifier:  Apache-2.0

config LIBFIXMATH
	bool "Enable libfixmath library"

config LIBFIXMATH_SINLUT
	bool "Enable lookup table for trigonometric functions, uses a lot of ROM"
	default y
```

## movement/Kconfig
```kconfig
# Copyright (c) 2025-2026 Tilmann Unte
# SPDX-License-Identifier:  Apache-2.0

config MOVEMENT
	bool "Enable support for basic movement API for Magni robot"
	depends on UR_MAGNI_DRIVER
	depends on LIBFIXMATH

choice MOVEMENT_DEADLINE_MISS_STRATEGY
	bool "Choice of deadline miss strategy for movement thread"
	default MOVEMENT_DEADLINE_MISS_STRATEGY_SKIP_NEXT

config MOVEMENT_DEADLINE_MISS_STRATEGY_SKIP_NEXT
	bool "Whenever a deadline miss occurs, the current job is finished and the next is skipped"

config MOVEMENT_DEADLINE_MISS_STRATEGY_QUEUE
	bool "Whenever a deadline miss occurs, the current job is finished and the next is queued and executed as soon as possible"

#config MOVEMENT_DEADLINE_MISS_STRATEGY_KILL
#	bool "Whenever a deadline miss occurs, the thread is aborted and reinitialized"

endchoice
```

## rplidar/Kconfig
```kconfig
# Copyright (c) 2022-2026 Tilmann Unte, Vinzenz Malke
# SPDX-License-Identifier:  Apache-2.0

config RPLIDAR
    bool "RPLidar sensor enable"
    depends on SERIAL
    
config RPLIDAR_MOTOR_CTRL
    bool "RPLidar motor speed control using PWM"
    depends on PWM

config RPLIDAR_EXPRESS_MODE
	bool "Software support for high frequency measurement mode"
	default y

choice RPLIDAR_DEADLINE_MISS_STRATEGY
	bool "Choice of deadline miss strategy for rplidar unpacker thread"
	default RPLIDAR_DEADLINE_MISS_STRATEGY_SKIP_NEXT

config RPLIDAR_DEADLINE_MISS_STRATEGY_SKIP_NEXT
	bool "Whenever a deadline miss occurs, the current job is finished and the next is skipped"

config RPLIDAR_DEADLINE_MISS_STRATEGY_QUEUE
	bool "Whenever a deadline miss occurs, the current job is finished and the next is queued and executed as soon as possible"

#config RPLIDAR_DEADLINE_MISS_STRATEGY_KILL
#	bool "Whenever a deadline miss occurs, the thread is aborted and reinitialized"

endchoice
```

## rplidar/dts/bindings/slamtech,rplidar.yaml
```yaml
# Copyright (c) 2022 Vinzenz Malke
# SPDX-License-Identifier:  Apache-2.0
description: |
  RPLidar sensor
compatible: "slamtech,rplidar"

include: uart-device.yaml

properties:
  pwms:
    required: false
    type: phandle-array
    description: |
      PWM for motor ctrl


    
```

## ur_magni/Kconfig
```kconfig
# Copyright (c) 2021-2026 Tilmann Unte
# SPDX-License-Identifier:  Apache-2.0

config UR_MAGNI_DRIVER
	bool "Enable support for Ubiquity Robotics Magni driver"
	depends on SERIAL

config UR_MAGNI_EXPANDER
	bool "Enable support for PCF8574 I2C GPIO Expander module. This is mandatory for non-standard Magni configurations!"
	depends on I2C
	depends on UR_MAGNI_DRIVER

choice UR_MAGNI_DEADLINE_MISS_STRATEGY
	bool "Choice of deadline miss strategy for Magni management threads"
	default UR_MAGNI_DEADLINE_MISS_STRATEGY_SKIP_NEXT

config UR_MAGNI_DEADLINE_MISS_STRATEGY_SKIP_NEXT
	bool "Whenever a deadline miss occurs, the current job is finished and the next is skipped"

config UR_MAGNI_DEADLINE_MISS_STRATEGY_QUEUE
	bool "Whenever a deadline miss occurs, the current job is finished and the next is queued and executed as soon as possible"

#config UR_MAGNI_DEADLINE_MISS_STRATEGY_KILL
#	bool "Whenever a deadline miss occurs, the thread is aborted and reinitialized"

endchoice
```

## ur_magni/dts/bindings/pcf8574.yaml
```yaml
# Copyright (c) 2021-2026 Tilmann Unte
# SPDX-License-Identifier:  Apache-2.0
description: generic 8 channel GPIO expander on I2C bus

compatible: "pcf8574"

include: i2c-device.yaml
```

## ur_magni/dts/bindings/ur,magni.yaml
```yaml
# Copyright (c) 2021-2026 Tilmann Unte
# SPDX-License-Identifier:  Apache-2.0
description: Ubiquity Robotics Magni Robot

compatible: "ur,magni"

include: uart-device.yaml

properties:
   i2c-bus:
      type: phandle
      description: I2C bus that connects to magni peripheral devices
```
